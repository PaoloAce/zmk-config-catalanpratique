## boards/shields/catalanpratique/Kconfig.defconfig
```kconfig
if SHIELD_CATALANPRATIQUE

config ZMK_KEYBOARD_NAME
    default "LaRep"

endif # SHIELD_CATALANPRATIQUE
```

## boards/shields/catalanpratique/Kconfig.shield
```kconfig
config SHIELD_CATALANPRATIQUE
    def_bool $(shields_list_contains,catalanpratique)
```
